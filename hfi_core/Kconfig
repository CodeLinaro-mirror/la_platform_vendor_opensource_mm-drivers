## hfi_core/Kconfig
```kconfig
config QTI_HFI_CORE
	bool "HFI Core"
	depends on QCOM_SMEM || ARCH_QTI_VM
	select QCOM_MDT_LOADER if ARCH_QCOM && !ARCH_QTI_VM
	select QCOM_SCM if !ARCH_QTI_VM
	select QCOM_PIL_INFO if !ARCH_QTI_VM
	help
	  Enable the hfi_core module

config HFI_CORE_DEBUG_FS
	bool "HFI Core Debug"
	help
	  Enable the hfi_core debug module

config HFI_CORE_SERAPH
	bool "HFI Core Seraph"
	help
	  flag for seraph target

config HFI_CORE_LOW_MEM
	bool "HFI Core Low Memory Target"
	help
	  Enable for low-memory targets (e.g., TVM) where memory constraints
	  are present. When enabled, HFI Core limits debug data collection
	  on such targets. For example, this entry can be used to limit the
	  number of trace events enabled for TVM.
```
